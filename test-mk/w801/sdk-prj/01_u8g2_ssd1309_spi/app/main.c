/*****************************************************************************
 *
 * File Name : main.c
 *
 * Description: main
 *
 * Date : 2022-06-05
 *****************************************************************************/

#include <stdio.h>
#include <stdlib.h>
#include <string.h>
//#include "wm_type_def.h"
//#include "wm_uart.h"
#include "wm_gpio.h"
//#include "wm_hostspi.h"
//#include "wm_socket.h"
//#include "wm_sockets.h"
//#include "wm_wifi.h"
//#include "wm_hspi.h"
//#include "wm_pwm.h"
//#include "wm_params.h"
#include "wm_osal.h"
//#include "wm_netif.h"
//#include "wm_efuse.h"
//#include "wm_mem.h"
#include "wm_cpu.h"
#include "wm_regs.h"
#include "wm_rtc.h"
#include "wm_timer.h"
#include "wm_watchdog.h"
//#include "csi_core.h"

#include "mod1/u8g2.h"
#include "u8x8_riotos.h"

/**
 * @brief   RIOT-OS logo, 64x32 pixels at 8 pixels per byte.
 */
static const uint8_t logo[] = {
  0x00, 0x00, 0x00, 0x00, 0x00, 0x00, 0x00, 0x00, 0x00, 0x00, 0x03, 0xE0, 0x00,
  0x00, 0x00, 0x00, 0x00, 0x00, 0x0F, 0xF8, 0x00, 0x00, 0x00, 0x00, 0x00, 0x00,
  0x1F, 0xF8, 0x00, 0x00, 0x00, 0x00, 0x00, 0x00, 0x3E, 0x3C, 0x00, 0x00, 0x00,
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  0x00, 0x00, 0x00, 0x00, 0x00, 0x00, 0x00, 0x00, 0x00
};

void
UserMain (void)
{
  printf ("user task\n");
  // tls_sys_clk_set(CPU_CLK_240M);

  uint32_t screen = 0;
  u8g2_t u8g2;

  /* initialize to SPI */
  puts ("Initializing to SPI.");

  u8x8_riotos_t user_data = {

    .pin_cs = WM_IO_PB_22,    // GPIO_PIN(PORT_A, 4),
    .pin_dc = WM_IO_PB_23,     // GPIO_UNDEF,
    .pin_reset = WM_IO_PB_21, // GPIO_PIN(PORT_A, 0),

    .spi_cs = WM_IO_PB_14, /* */
    .spi_ck = WM_IO_PB_15, /* */
    .spi_di = WM_IO_PB_16, /* */
    .spi_do = WM_IO_PB_17, /* */
  };

  u8g2_SetUserPtr (&u8g2, &user_data);

  u8g2_Setup_ssd1309_128x64_noname2_1 (&u8g2, U8G2_R0, u8x8_byte_hw_spi_riotos,
                                u8x8_gpio_and_delay_riotos);

  u8g2_SetUserPtr (&u8g2, &user_data);

  /* initialize the display */
  puts ("Initializing display.");

  u8g2_InitDisplay (&u8g2);
  u8g2_SetPowerSave (&u8g2, 0);

  /* start drawing in a loop */
  puts ("Drawing on screen.");

  while (1)
    {
      u8g2_FirstPage (&u8g2);

      do
        {
          u8g2_SetDrawColor (&u8g2, 1);
          u8g2_SetFont (&u8g2, u8g2_font_helvB12_tf);

          switch (screen)
            {
            case 0:
              u8g2_DrawStr (&u8g2, 12, 22, "THIS");
              break;
            case 1:
              u8g2_DrawStr (&u8g2, 24, 22, "IS");
              break;
            case 2:
              u8g2_DrawBitmap (&u8g2, 0, 0, 8, 32, logo);
              break;
            case 4:
              u8g2_DrawStr (&u8g2, 24, 22, "Vova Hi !");
              break;
            case 5:
              u8g2_DrawStr (&u8g2, 4, 42, "Everything Ok !");
              break;
            case 6:
              u8g2_DrawDisc (&u8g2, 10, 18, 9, U8G2_DRAW_ALL);
              u8g2_DrawCircle (&u8g2, 10, 18 + 30, 9, U8G2_DRAW_ALL);
              u8g2_DrawLine (&u8g2, 7, 10, 40, 55);
              u8g2_DrawBox (&u8g2, 50, 10, 20, 10);
              u8g2_DrawFrame (&u8g2, 50, 10 + 30, 20, 10);
              break;
            }
        }
      while (u8g2_NextPage (&u8g2));

      /* show screen in next iteration */
      // screen = (screen + 1) % 3;
      if (++screen > 6)
        screen = 0;

      /* sleep a little */
      tls_os_time_delay (HZ);
    }
}
